## include/linux/sched_assist/Kconfig
```kconfig
config OPLUS_FEATURE_SCHED_SPREAD
	bool "sched_spread"
	default n
	help
	  This is the uifirst 5.0 feature, which will spread tasks,
	  kick runnable time from task demand and adjust bg's time slice.
config OPLUS_FEATURE_AUDIO_OPT
	bool "config audio opt"
	default n
	help
	  audio task schedule opt.
```
